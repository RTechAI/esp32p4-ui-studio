## firmware/ForgeUI-One/main/Kconfig.projbuild
```kconfig
menu "ForgeUI project hardware"

config FORGEUI_SD_ENABLED
    bool "SD runtime enabled"
    default y

config FORGEUI_SD_SLOT
    int "SDMMC host slot"
    range 0 1
    default 0

config FORGEUI_SD_WIDTH
    int "SDMMC bus width"
    range 1 4
    default 4

config FORGEUI_SD_FREQ_KHZ
    int "SDMMC maximum frequency (kHz)"
    default 40000

config FORGEUI_SD_CLK
    int "SD CLK GPIO"
    default 43
config FORGEUI_SD_CMD
    int "SD CMD GPIO"
    default 44
config FORGEUI_SD_D0
    int "SD D0 GPIO"
    default 39
config FORGEUI_SD_D1
    int "SD D1 GPIO"
    default 40
config FORGEUI_SD_D2
    int "SD D2 GPIO"
    default 41
config FORGEUI_SD_D3
    int "SD D3 GPIO"
    default 42
config FORGEUI_SD_LDO_CHANNEL
    int "SD power LDO channel"
    range 0 4
    default 4
config FORGEUI_SD_LDO_MV
    int "SD power LDO voltage (mV)"
    default 2500

endmenu
```

## firmware/ForgeUI-One/sdkconfig.defaults
```kconfig
# ForgeUI RC1 sdkconfig.defaults
# ESP-IDF 5.5.4
# Target: ESP32-P4-WIFI6-Touch-LCD-7B
#
# Generated from known-good ForgeUI baseline.
# Keep PSRAM XIP OFF for Hosted WiFi builds.

CONFIG_IDF_TARGET="esp32p4"
CONFIG_ESP32P4_SELECTS_REV_LESS_V3=y
CONFIG_ESP32P4_REV_MIN_1=y
CONFIG_ESPTOOLPY_FLASHMODE_QIO=y
CONFIG_ESPTOOLPY_FLASHSIZE_16MB=y
CONFIG_PARTITION_TABLE_CUSTOM=y
CONFIG_COMPILER_OPTIMIZATION_PERF=y
CONFIG_SPIRAM=y
CONFIG_SPIRAM_SPEED_200M=y
# CONFIG_SPIRAM_XIP_FROM_PSRAM is not set
CONFIG_SPIRAM_MALLOC_ALWAYSINTERNAL=1024
CONFIG_SPIRAM_MALLOC_RESERVE_INTERNAL=32768
CONFIG_CACHE_L2_CACHE_256KB=y
CONFIG_CACHE_L2_CACHE_LINE_128B=y
CONFIG_ESP_MAIN_TASK_STACK_SIZE=10240
CONFIG_FREERTOS_HZ=1000
CONFIG_FREERTOS_VTASKLIST_INCLUDE_COREID=y
CONFIG_FREERTOS_GENERATE_RUN_TIME_STATS=y
CONFIG_LV_USE_CLIB_MALLOC=y
CONFIG_LV_USE_CLIB_STRING=y
CONFIG_LV_USE_CLIB_SPRINTF=y
CONFIG_LV_DEF_REFR_PERIOD=15
CONFIG_LV_OS_FREERTOS=y
CONFIG_LV_DRAW_SW_DRAW_UNIT_CNT=2
CONFIG_LV_ATTRIBUTE_FAST_MEM_USE_IRAM=y
CONFIG_LV_FONT_MONTSERRAT_10=y
CONFIG_LV_FONT_MONTSERRAT_12=y
CONFIG_LV_FONT_MONTSERRAT_16=y
CONFIG_LV_FONT_MONTSERRAT_18=y
CONFIG_LV_FONT_MONTSERRAT_20=y
CONFIG_LV_FONT_MONTSERRAT_22=y
CONFIG_LV_FONT_MONTSERRAT_24=y
CONFIG_LV_FONT_MONTSERRAT_26=y
CONFIG_LV_FONT_MONTSERRAT_28=y
CONFIG_LV_FONT_MONTSERRAT_30=y
CONFIG_LV_FONT_MONTSERRAT_32=y
CONFIG_LV_FONT_MONTSERRAT_36=y
CONFIG_LV_FONT_MONTSERRAT_40=y
CONFIG_LV_FONT_MONTSERRAT_48=y
CONFIG_LV_USE_FONT_COMPRESSED=y
CONFIG_LV_TXT_BREAK_CHARS=" ,.;:-_"
CONFIG_LV_USE_SYSMON=y
CONFIG_LV_USE_PERF_MONITOR=y
CONFIG_LV_USE_IMGFONT=y
CONFIG_LV_USE_QRCODE=y
CONFIG_LV_USE_SPAN=y
CONFIG_LV_USE_ANIMIMG=y
CONFIG_LV_USE_IMAGEBUTTON=y
CONFIG_LV_USE_WIN=y
CONFIG_LV_USE_MENU=y
CONFIG_LV_USE_FLEX=y
CONFIG_LV_USE_TEXTAREA=y
CONFIG_LV_USE_SPINBOX=y
CONFIG_LV_USE_LIST=y
CONFIG_LV_USE_TILEVIEW=y
# CONFIG_LV_USE_DEMO_WIDGETS is not set
# CONFIG_LV_USE_DEMO_BENCHMARK is not set
# CONFIG_LV_USE_DEMO_RENDER is not set
# CONFIG_LV_USE_DEMO_SCROLL is not set
# CONFIG_LV_USE_DEMO_STRESS is not set
# CONFIG_LV_USE_DEMO_TRANSFORM is not set
# CONFIG_LV_USE_DEMO_MUSIC is not set
# CONFIG_LV_DEMO_MUSIC_AUTO_PLAY is not set
# CONFIG_LV_USE_DEMO_FLEX_LAYOUT is not set
# CONFIG_LV_USE_DEMO_MULTILANG is not set
CONFIG_IDF_EXPERIMENTAL_FEATURES=y

# CONFIG_ESP_WIFI_REMOTE_ENABLED is not set
# CONFIG_FORGEUI_SD_ENABLED is not set

# CONFIG_ESP_WIFI_REMOTE_ENABLED is not set
# CONFIG_FORGEUI_SD_ENABLED is not set

# CONFIG_ESP_WIFI_REMOTE_ENABLED is not set
# CONFIG_FORGEUI_SD_ENABLED is not set

# CONFIG_ESP_WIFI_REMOTE_ENABLED is not set
# CONFIG_FORGEUI_SD_ENABLED is not set

# CONFIG_ESP_WIFI_REMOTE_ENABLED is not set
# CONFIG_FORGEUI_SD_ENABLED is not set

# CONFIG_ESP_WIFI_REMOTE_ENABLED is not set
# CONFIG_FORGEUI_SD_ENABLED is not set

# CONFIG_ESP_WIFI_REMOTE_ENABLED is not set
# CONFIG_FORGEUI_SD_ENABLED is not set

# CONFIG_ESP_WIFI_REMOTE_ENABLED is not set
# CONFIG_FORGEUI_SD_ENABLED is not set

# CONFIG_ESP_WIFI_REMOTE_ENABLED is not set
# CONFIG_FORGEUI_SD_ENABLED is not set

# CONFIG_ESP_WIFI_REMOTE_ENABLED is not set
# CONFIG_FORGEUI_SD_ENABLED is not set

# CONFIG_ESP_WIFI_REMOTE_ENABLED is not set
# CONFIG_FORGEUI_SD_ENABLED is not set

# CONFIG_ESP_WIFI_REMOTE_ENABLED is not set
# CONFIG_FORGEUI_SD_ENABLED is not set

# CONFIG_ESP_WIFI_REMOTE_ENABLED is not set
# CONFIG_FORGEUI_SD_ENABLED is not set
CONFIG_MBEDTLS_CERTIFICATE_BUNDLE=y

# CONFIG_ESP_WIFI_REMOTE_ENABLED is not set
# CONFIG_FORGEUI_SD_ENABLED is not set

# CONFIG_FORGEUI_SD_ENABLED is not set

# CONFIG_FORGEUI_SD_ENABLED is not set

# CONFIG_FORGEUI_SD_ENABLED is not set

# CONFIG_FORGEUI_SD_ENABLED is not set

# CONFIG_FORGEUI_SD_ENABLED is not set

# CONFIG_FORGEUI_SD_ENABLED is not set

# CONFIG_FORGEUI_SD_ENABLED is not set
# Example 04 HTTPS coexists with ESP-Hosted SDIO: avoid hardware-AES DMA
# descriptor allocations and release TLS RX/TX buffers when they are idle.
# CONFIG_MBEDTLS_HARDWARE_AES is not set
CONFIG_MBEDTLS_DYNAMIC_BUFFER=y
# CONFIG_MBEDTLS_DEBUG is not set
# CONFIG_MBEDTLS_INTERNAL_MEM_ALLOC is not set
CONFIG_MBEDTLS_DEFAULT_MEM_ALLOC=y

# CONFIG_FORGEUI_SD_ENABLED is not set

# Generated from ForgeUI project hardware profile.
CONFIG_ESP_HOSTED_ENABLED=y
CONFIG_ESP_HOSTED_IDF_SLAVE_TARGET="esp32c6"
CONFIG_ESP_HOSTED_SDIO_HOST_INTERFACE=y
# CONFIG_ESP_HOSTED_SPI_HOST_INTERFACE is not set
CONFIG_ESP_HOSTED_SDIO_4_BIT_BUS=y
CONFIG_ESP_HOSTED_SDIO_CLOCK_FREQ_KHZ=40000
CONFIG_ESP_HOSTED_SDIO_PIN_CLK=18
CONFIG_ESP_HOSTED_SDIO_PIN_CMD=19
CONFIG_ESP_HOSTED_SDIO_PIN_D0=14
CONFIG_ESP_HOSTED_SDIO_PRIV_PIN_D1_4BIT_BUS=15
CONFIG_ESP_HOSTED_SDIO_PIN_D2=16
CONFIG_ESP_HOSTED_SDIO_PIN_D3=17
CONFIG_ESP_HOSTED_SDIO_GPIO_RESET_SLAVE=54
CONFIG_ESP_HOSTED_SDIO_TX_Q_SIZE=20
CONFIG_ESP_HOSTED_SDIO_RX_Q_SIZE=20
# CONFIG_ESP_HOSTED_SDIO_OPTIMIZATION_RX_NONE is not set
# CONFIG_ESP_HOSTED_SDIO_OPTIMIZATION_RX_MAX_SIZE is not set
CONFIG_ESP_HOSTED_SDIO_OPTIMIZATION_RX_STREAMING_MODE=y
CONFIG_ESP_WIFI_REMOTE_ENABLED=y
CONFIG_ESP_WIFI_REMOTE_LIBRARY_HOSTED=y
CONFIG_SLAVE_IDF_TARGET_ESP32C6=y
# CONFIG_FORGEUI_SD_ENABLED is not set
CONFIG_FORGEUI_SD_SLOT=0
CONFIG_FORGEUI_SD_WIDTH=4
CONFIG_FORGEUI_SD_FREQ_KHZ=40000
CONFIG_FORGEUI_SD_CLK=43
CONFIG_FORGEUI_SD_CMD=44
CONFIG_FORGEUI_SD_D0=39
CONFIG_FORGEUI_SD_D1=40
CONFIG_FORGEUI_SD_D2=41
CONFIG_FORGEUI_SD_D3=42
CONFIG_FORGEUI_SD_LDO_CHANNEL=4
CONFIG_FORGEUI_SD_LDO_MV=2500
```
